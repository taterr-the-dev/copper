## Kconfig
```kconfig
source "kernel/Kconfig"
source "drivers/Kconfig"
source "fs/Kconfig"
source "net/Kconfig"

config DEBUG_EXEC
    bool "Exec address-space debug walk"
    default n
```

## arch/x86/Kconfig
```kconfig
#
# x86 Architecture Configuration
#

config X86_64
	bool "64-bit kernel"
	depends on ARCH_X86
	default y
	help
		Build a 64-bit kernel for x86-64 processors.

config SERIAL_BAUD
	int "Default serial baud rate"
	default 115200
```

## drivers/Kconfig
```kconfig
menu "Console and display"

config CONSOLE
	bool "Unified kernel console"
	default y

config SERIAL_UART
	bool "UART serial console"
	depends on CONSOLE
	default y

config SERIAL_PORT
	int "Serial port index"
	depends on SERIAL_UART
	default 0

config SERIAL_BAUD
	int "Serial baud rate"
	depends on SERIAL_UART
	default 115200

config VGA_TEXT
	bool "VGA text console"
	depends on CONSOLE
	default y

config VGA_WIDTH
	int "VGA text columns"
	depends on VGA_TEXT
	default 80

config VGA_HEIGHT
	int "VGA text rows"
	depends on VGA_TEXT
	default 25

config TTY
	bool "Enable TTY/PTY Subsystem"
	default y
	help
	  Enables the core TTY layer, line discipline, and Pseudo-Terminals.

endmenu

menu "Block devices"

config RAMDISK
	bool "Multiboot module RAM disk"
	default y

config PCI_RAMDISK
    bool "PCI-based RAM disk (ivshmem)"
    default y

config ATA
	bool "ATA IDE PIO disk driver"
	default y

endmenu

menu "Input devices"

config PS2_KEYBOARD
	bool "PS/2 keyboard driver"
	depends on INTERRUPTS
	default y

endmenu
```

## fs/Kconfig
```kconfig
menu "Filesystems"

config FS_VFS
	bool "Virtual filesystem switch"
	default y

config FS_FAT12
	bool "FAT12 filesystem (floppy disks)"
	depends on FS_VFS
	default y

config FS_FAT16
	bool "FAT16 filesystem (old USB drives / SD cards)"
	depends on FS_VFS
	default y

config FS_FAT32
	bool "FAT32 filesystem (modern USB drives / SD cards)"
	depends on FS_VFS
	default y

config FS_EXT4
	bool "ext4 filesystem (with indirect block fallback)"
	depends on FS_VFS
	default y

config FS_EXT3
	bool "ext3 filesystem (journal-aware)"
	depends on FS_VFS
	default y

config FS_EXT2
	bool "ext2 filesystem"
	depends on FS_VFS
	default y

config FS_PROC
	bool "procfs virtual filesystem"
	depends on FS_VFS
	default y

config FS_TMPFS
	bool "tmpfs RAM filesystem"
	depends on FS_VFS
	default y

endmenu
```

## kernel/Kconfig
```kconfig
menu "Boot options"

config MULTIBOOT
	bool "Multiboot boot protocol"
	default y

config FLAT_BINARY_BOOT
	bool "Boot as raw flat binary"
	default y

endmenu

menu "Executable formats and loaders"

config ELF_LOADER
	bool "ELF binary loader"
	default y

config ELF_64
	bool "64-bit ELF support"
	depends on ELF_LOADER
	default y

config ELF_MAX_SEGMENTS
	int "Maximum program segments per ELF"
	depends on ELF_LOADER
	default 8

config BINFMT_ELF
	bool "ELF executable format"
	depends on ELF_LOADER
	default y

config BINFMT_SHEBANG
	bool "Shebang script executable support"
	default y

config EXECVE
	bool "execve ELF loader"
	depends on USERMODE
	default y

config ELF_INTERP
	bool "ELF interpreter support"
	depends on EXECVE
	default y
	help
	  Load the program interpreter and build the Linux auxv stack
	  so dynamically-linked ELFs (shared libraries) can run.

endmenu

menu "System calls"

config SYSCALLS
	bool "Enable system call interface"
	default y

config LINUX_SYSCALL_ABI
	bool "Linux-compatible syscall ABI"
	depends on SYSCALLS
	default y

config FORK
	bool "fork syscall (shared-address-space)"
	depends on USERMODE && KMALLOC
	default y
	help
	  fork creates a child task that resumes after the parent's
	  syscall with rax = 0. Currently shares the address space
	  (vfork-like).

endmenu

menu "Memory management"

config KMALLOC
	bool "Kernel heap allocator"
	default y

config VM
	bool "Per-process address spaces (PMM + paging + mmap)"
	depends on KMALLOC
	default y

endmenu

menu "Interrupts and timers"

config INTERRUPTS
	bool "Hardware interrupts"
	default y

config PIT_TIMER
	bool "PIT periodic timer"
	depends on INTERRUPTS
	default y

endmenu

menu "Process management"

config SCHED
	bool "Preemptive round-robin scheduler"
	depends on INTERRUPTS
	default y

config SCHED_HZ
	int "Scheduler tick rate"
	depends on SCHED
	default 100

config TASK_TSS
	bool "Per-task TSS kernel stacks"
	depends on SCHED
	default y

config PROC_EXIT
	bool "Per-process exit and wait"
	depends on SCHED
	default y

config USERMODE
	bool "User mode ring 3 support"
	depends on SCHED
	default y

endmenu

menu "Kernel debugging"

config PANIC_REBOOT
	bool "Reboot on panic (otherwise halt)"
	default n
	help
	  If set, a panic issues an 8042 reset; otherwise the kernel halts.

config PANIC_SELFTEST
	bool "Trigger a panic at boot (testing)"
	default n
	help
	  Call panic() during boot to verify the panic screen.

endmenu

menu "Init options"

config RUN_INIT
	bool "Run an init program at boot"
	depends on EXECVE
	default y
	help
	  Automatically execute a program after boot. The format is
	  auto-detected (ELF or #!script).

config INIT_PATH
	string "Init program path"
	depends on RUN_INIT
	default "/init"

endmenu

menu "Debug output"

config DEBUG_SYSCALL
	bool "Trace syscalls and exits"
	default n

config FS_VERBOSE
	bool "Verbose filesystem messages"
	default n

endmenu
```

## misc/Kconfig
```kconfig
#
#Miscellaneous Configuration
#

menu "Miscellaneous options"

config USE_CUSTOM_BOOTLOADER
    bool "Use custom Copper bootloader (instead of GRUB)"
    default n
    help
      When enabled, 'make test' will build and boot the kernel using
      the custom Copper bootloader instead of GRUB.
      Leave disabled to keep using GRUB for testing.

config MISC_VERBOSE_BOOT
    bool "Verbose boot messages"
    default n
    help
      Print extra information during early boot.

endmenu
```

## net/Kconfig
```kconfig
menu "Networking Support"

config NET
    bool "Enable networking stack"
    default y
    help
      Enable the core networking stack and socket syscalls.

config NET_RTL8139
    bool "Realtek RTL8139 PCI Ethernet driver"
    depends on net
    default y
    help
      Driver for the very common Realtek RTL8139 PCI network card.
      (Use 'pci -nn' in QEMU or your host to verify it's 10ec:8139).

config NET_E1000
    bool "Intel E1000 PCI Ethernet driver"
    depends on NET
    default y
    help
      Driver for the Intel PRO/1000 (E1000) Gigabit Ethernet adapter.
      (Use '-device e1000' in QEMU to emulate this card).

config NET_IPV4_UDP
    bool "IPv4 and UDP support"
    depends on net
    default y
    help
      Minimal IPv4 routing and UDP transport layer.

config NET_IP_ADDR
    depends on net
    string "Default IP Address"
    default "0xC0A80164"
    help
      The static IP address for the copper kernel.

config NET_SUBNET_MASK
    depends on net
    string "Default Subnet Mask"
    default "0xFFFFFF00"

config NET_GATEWAY
    depends on net
    string "Default Gateway"
    default "0xC0A80101"

endmenu
```
